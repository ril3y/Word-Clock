;*****************************************************************************
; PIC18F family - cues and playback data file
;*****************************************************************************
;
;    Filename:	    	eFruit_cue_data.inc
;    Author, Company:	Alden Hart, Luke's Lights
;    Chip Support:	Supports PIC18F family
;    Revision:		090711
;
; TABLE STRUCTURE:
;     PLAYLIST_MASTER_TABLE	List of playlists - one or more playlists
;				Can be selected by:
; 				  	PLAYLIST command (run numbered playlist) 
;					PLAY_NEXT_PLAYLIST (end of previous playlist)
;					PLAY_PREV_PLAYLIST
;
;     PLAYLIST_CUE_NUMBER_TABLE	Set of numbered cues for calling from commands
;				Can be selected by:
; 				  	CUE command (run numbered cue) 
;
;     PLAYLIST_xxxxxx		Individual playlists - one or more cues each
;				Advances by WATCH command, does LOOPING
;
;     CUE_xxxxxx		Individial cues - one or more commands each

DATA_LED_DATA_TABLES	code	; set to align on 16 bit word boundaries

;******************************************************************************
; PLAYLIST MASTER TABLE
; Points to one or more playlists. 

	data	PLAYLIST_DONE	; REQUIRED
PLAYLIST_MASTER_TABLE
	data	PLAYLIST_01	; This will get executed on power-up reset
	data	PLAYLIST_02
	data	PLAYLIST_DONE	; REQUIRED


;******************************************************************************
; CUE NUMBER TABLE
; A playlist containing cues that rae accessed by nuymber using the CUE command
; The first cue is #00 and is ALL OFF by convention

CUE_NUMBER_TABLE
	data	PLAYLIST_DONE	; REQUIRED

;---- mapping to this table
_ALL_OFF	equ	.00
_ALL_ON		equ	.01
_ALL_OFF_XFADE	equ	.02
_ALL_ON_XFADE	equ	.03

;******************************************************************************
; PLAYLIST TABLES

PLAYLIST_01
;	data	CUE_ALL_ON
	data	CUE_ALL_DIM
;	data	CUE_ALL_OFF
	data	PLAYLIST_DONE	; REQUIRED

PLAYLIST_02
	data	CUE_ALL_OFF
	data	PLAYLIST_DONE	; REQUIRED

;******************************************************************************
; Cue command line templates (very useful)
; SET_BRT 	CUE_CMD SET_BRT  mask  chn  brt 	
; SET_HSB 	CUE_CMD SET_HSB  mask  chn  hue     sat     brt 	
; PATCH 	CUE_CMD PATCH  mask slave_ckt master_ckt
; FADE		CUE_CMD FADE mask ckt_num pres wait up dwell down off 	
; FADE_MAX	CUE_CMD FADE_MAX mask cktnum scal wait up  dwell down off  rpt  min  max 
; FADE_XFADE	CUE_CMD FADE_XFADE maskHmaskL cktnum scal wait up  dwell down off  rpt  min  max  xfade
; ARG op1 	CUE_ARG arg# opcode 		op1
; ARG op3 	CUE_ARG arg# opcode        	op1, 	op2,	op3
;	db	CUE_ARG,	1,  OP_INCX3_RANGE,	0x00,	0xC0,	0x00

;****** wCLOCK APPLICATION SPECIFIC TABLES **********
; cues for 5 minute intervals, hours, and plus signs
; These tables are indexed directly by the clock display routines

CLK_MINUTES_MAP
	data	CUE_MINUTES_00
	data	CUE_MINUTES_05
	data	CUE_MINUTES_10
	data	CUE_MINUTES_15
	data	CUE_MINUTES_20
	data	CUE_MINUTES_25
	data	CUE_MINUTES_30
	data	CUE_MINUTES_35
	data	CUE_MINUTES_40
	data	CUE_MINUTES_45
	data	CUE_MINUTES_50
	data	CUE_MINUTES_55
	data	CUE_PANIC		; should never hit this one

CLK_HOURS_MAP
	data	CUE_HOURS_OFF		; 0=dummy. never should get hit
	data	CUE_HOURS_01
	data	CUE_HOURS_02
	data	CUE_HOURS_03
	data	CUE_HOURS_04
	data	CUE_HOURS_05
	data	CUE_HOURS_06
	data	CUE_HOURS_07
	data	CUE_HOURS_08
	data	CUE_HOURS_09
	data	CUE_HOURS_10
	data	CUE_HOURS_11
	data	CUE_HOURS_12
	data	CUE_PANIC		; should never hit this one

;CLK_PLUS_MAP
;	data	CUE_PLUS_0
;	data	CUE_PLUS_1
;	data	CUE_PLUS_2
;	data	CUE_PLUS_3
;	data	CUE_PLUS_4


;******************************************************************************
; Cues

DATA_LED_DATA_CUES	code_pack ; set to align on 8 bit byte boundaries

;---- common equates used across cues

LIT	equ	0xFF		; maximum brightness for SET_LIT commands
DIM	equ	0x80		; dim brightness
XMAX	equ	0xFF		; maximum brightness for cross fades
XMIN	equ	0x00		; minumum brightness for cross fades
XFADE	equ	0x20		; cross fade time

CUE_ALL_OFF_XFADE
; FADE_X	CUE_CMD FADE_X maskHmaskL channel scal wait up  dwell down off  rpt  min  max  xfade
;	db	CUE_CMD,FADE_X,0x00,0x00, ITS,    0x01,0x00,0x00,0x00,0x00,0x00,0x01,XMAX,XMAX,XFADE
; FADE_X	CUE_CMD FADE_X mask channel s,w,u,d,d,o,r,min, max, xfade
;	db	CUE_CMD,FADE_X,0,0, ITS,    1,0,0,0,0,0,1,XMIN,XMIN,XFADE
;	db	CUE_CMD,WATCH,0x00,NEVER
	db	CUE_DONE

; FADE_X	CUE_CMD FADE_X mask channel s,w,u,n,d,f,r,min, max, xfade
;	db	CUE_CMD,FADE_X, 0, ITS,     1,0,0,0,0,0,1,XMAX,XMAX,XFADE
;	db	CUE_CMD,FADE_X, 0, HALF,    1,0,0,0,0,0,1,XMIN,XMIN,XFADE
;	db	CUE_CMD,FADE_X, 0, TEN_,    1,0,0,0,0,0,1,XMIN,XMIN,XFADE
;	db	CUE_CMD,FADE_X, 0, QUARTER, 1,0,0,0,0,0,1,XMIN,XMIN,XFADE
;	db	CUE_CMD,FADE_X, 0, TWENTY,  1,0,0,0,0,0,1,XMIN,XMIN,XFADE
;	db	CUE_CMD,FADE_X, 0, FIVE_,   1,0,0,0,0,0,1,XMAX,XMAX,XFADE
;	db	CUE_CMD,FADE_X, 0, MINUTES, 1,0,0,0,0,0,1,XMAX,XMAX,XFADE
;	db	CUE_CMD,FADE_X, 0, PAST,    1,0,0,0,0,0,1,XMAX,XMAX,XFADE
;	db	CUE_CMD,FADE_X, 0, TO, 	    1,0,0,0,0,0,1,XMIN,XMIN,XFADE
;	db	CUE_CMD,FADE_X, 0, OCLOCK,  1,0,0,0,0,0,1,XMIN,XMIN,XFADE
;	db	CUE_CMD,WATCH,0x00,NEVER
;	db	CUE_DONE

CUE_ALL_ON_XFADE
; FADE_X	CUE_CMD FADE_X mask channel s,w,u,d,d,o,r,min, max, xfade
;	db	CUE_CMD,FADE_X,0,0, ITS,    1,0,0,0,0,0,1,XMAX,XMAX,XFADE
;	db	CUE_CMD,WATCH,0x00,NEVER
	db	CUE_DONE

CUE_MINUTES_OFF
; SET_BRT 	CUE_CMD SET_BRT  mask  chn  brt 	
	db	CUE_CMD,SET_BRT, 0x00, ITS, 0		; IT'S
	db	CUE_CMD,SET_BRT, 0x00, HALF, 0		; HALF
	db	CUE_CMD,SET_BRT, 0x00, TEN_, 0		; TEN_
	db	CUE_CMD,SET_BRT, 0x00, QUARTER, 0	; QUARTER
	db	CUE_CMD,SET_BRT, 0x00, TWENTY, 0	; TWENTY
	db	CUE_CMD,SET_BRT, 0x00, FIVE_, 0		; FIVE
	db	CUE_CMD,SET_BRT, 0x00, MINUTES, 0	; MINUTES
	db	CUE_CMD,SET_BRT, 0x00, PAST, 0		; PAST
	db	CUE_CMD,SET_BRT, 0x00, TO_, 0		; TO
	db	CUE_CMD,SET_BRT, 0x00, OCLOCK, 0	; O'CLOCK
;	db	CUE_CMD,WATCH,0x00,NEVER
	db	CUE_DONE

CUE_MINUTES_00
; SET_BRT 	CUE_CMD SET_BRT  mask  chn  brt 	
	db	CUE_CMD,SET_BRT, 0x00, ITS, 0		; IT'S
	db	CUE_CMD,SET_BRT, 0x00, HALF, 0		; HALF
	db	CUE_CMD,SET_BRT, 0x00, TEN_, 0		; TEN_
	db	CUE_CMD,SET_BRT, 0x00, QUARTER, 0	; QUARTER
	db	CUE_CMD,SET_BRT, 0x00, TWENTY, 0	; TWENTY
	db	CUE_CMD,SET_BRT, 0x00, FIVE_, 0		; FIVE
	db	CUE_CMD,SET_BRT, 0x00, MINUTES, 0	; MINUTES
	db	CUE_CMD,SET_BRT, 0x00, PAST, 0		; PAST
	db	CUE_CMD,SET_BRT, 0x00, TO_, 0		; TO_
	db	CUE_CMD,SET_BRT, 0x00, OCLOCK, LIT	; O'CLOCK
;	db	CUE_CMD,WATCH,0x00,NEVER
	db	CUE_DONE

CUE_MINUTES_05
; SET_BRT 	CUE_CMD SET_BRT  mask  chn  brt 	
	db	CUE_CMD,SET_BRT, 0x00, ITS, LIT		; IT'S
	db	CUE_CMD,SET_BRT, 0x00, HALF, 0		; HALF
	db	CUE_CMD,SET_BRT, 0x00, TEN_, 0		; TEN_
	db	CUE_CMD,SET_BRT, 0x00, QUARTER, 0	; QUARTER
	db	CUE_CMD,SET_BRT, 0x00, TWENTY, 0	; TWENTY
	db	CUE_CMD,SET_BRT, 0x00, FIVE_, LIT	; FIVE
	db	CUE_CMD,SET_BRT, 0x00, MINUTES, LIT	; MINUTES
	db	CUE_CMD,SET_BRT, 0x00, PAST, LIT	; PAST
	db	CUE_CMD,SET_BRT, 0x00, TO_, 0		; TO_
	db	CUE_CMD,SET_BRT, 0x00, OCLOCK, 0	; O'CLOCK
;	db	CUE_CMD,WATCH,0x00,NEVER
	db	CUE_DONE

CUE_MINUTES_10
; SET_BRT 	CUE_CMD SET_BRT  mask  chn  brt 	
	db	CUE_CMD,SET_BRT, 0x00, ITS, LIT		; IT'S
	db	CUE_CMD,SET_BRT, 0x00, HALF, 0		; HALF
	db	CUE_CMD,SET_BRT, 0x00, TEN_, LIT	; TEN_
	db	CUE_CMD,SET_BRT, 0x00, QUARTER, 0	; QUARTER
	db	CUE_CMD,SET_BRT, 0x00, TWENTY, 0	; TWENTY
	db	CUE_CMD,SET_BRT, 0x00, FIVE_, 0		; FIVE
	db	CUE_CMD,SET_BRT, 0x00, MINUTES, 0	; MINUTES
	db	CUE_CMD,SET_BRT, 0x00, PAST, LIT	; PAST
	db	CUE_CMD,SET_BRT, 0x00, TO_, 0		; TO_
	db	CUE_CMD,SET_BRT, 0x00, OCLOCK, 0	; O'CLOCK
;	db	CUE_CMD,WATCH,0x00,NEVER
	db	CUE_DONE

CUE_MINUTES_15
; SET_BRT 	CUE_CMD SET_BRT  mask  chn  brt 	
	db	CUE_CMD,SET_BRT, 0x00, ITS, LIT		; IT'S
	db	CUE_CMD,SET_BRT, 0x00, HALF, 0		; HALF
	db	CUE_CMD,SET_BRT, 0x00, TEN_, 0		; TEN_
	db	CUE_CMD,SET_BRT, 0x00, QUARTER, LIT	; QUARTER
	db	CUE_CMD,SET_BRT, 0x00, TWENTY, 0	; TWENTY
	db	CUE_CMD,SET_BRT, 0x00, FIVE_, 0		; FIVE
	db	CUE_CMD,SET_BRT, 0x00, MINUTES, 0	; MINUTES
	db	CUE_CMD,SET_BRT, 0x00, PAST, LIT	; PAST
	db	CUE_CMD,SET_BRT, 0x00, TO_, 0		; TO_
	db	CUE_CMD,SET_BRT, 0x00, OCLOCK, 0	; O'CLOCK
;	db	CUE_CMD,WATCH,0x00,NEVER
	db	CUE_DONE

CUE_MINUTES_20
; SET_BRT 	CUE_CMD SET_BRT  mask  chn  brt 	
	db	CUE_CMD,SET_BRT, 0x00, ITS, LIT		; IT'S
	db	CUE_CMD,SET_BRT, 0x00, HALF, 0		; HALF
	db	CUE_CMD,SET_BRT, 0x00, TEN_, 0		; TEN_
	db	CUE_CMD,SET_BRT, 0x00, QUARTER, 0	; QUARTER
	db	CUE_CMD,SET_BRT, 0x00, TWENTY, LIT	; TWENTY
	db	CUE_CMD,SET_BRT, 0x00, FIVE_, 0		; FIVE
	db	CUE_CMD,SET_BRT, 0x00, MINUTES, 0	; MINUTES
	db	CUE_CMD,SET_BRT, 0x00, PAST, LIT	; PAST
	db	CUE_CMD,SET_BRT, 0x00, TO_, 0		; TO_
	db	CUE_CMD,SET_BRT, 0x00, OCLOCK, 0	; O'CLOCK
;	db	CUE_CMD,WATCH,0x00,NEVER
	db	CUE_DONE

CUE_MINUTES_25
; SET_BRT 	CUE_CMD SET_BRT  mask  chn  brt 	
	db	CUE_CMD,SET_BRT, 0x00, ITS, LIT		; IT'S
	db	CUE_CMD,SET_BRT, 0x00, HALF, 0		; HALF
	db	CUE_CMD,SET_BRT, 0x00, TEN_, 0		; TEN_
	db	CUE_CMD,SET_BRT, 0x00, QUARTER, 0	; QUARTER
	db	CUE_CMD,SET_BRT, 0x00, TWENTY, LIT	; TWENTY
	db	CUE_CMD,SET_BRT, 0x00, FIVE_, LIT	; FIVE
	db	CUE_CMD,SET_BRT, 0x00, MINUTES, LIT	; MINUTES
	db	CUE_CMD,SET_BRT, 0x00, PAST, LIT	; PAST
	db	CUE_CMD,SET_BRT, 0x00, TO_, 0		; TO_
	db	CUE_CMD,SET_BRT, 0x00, OCLOCK, 0	; O'CLOCK
;	db	CUE_CMD,WATCH,0x00,NEVER
	db	CUE_DONE

CUE_MINUTES_30
; SET_BRT 	CUE_CMD SET_BRT  mask  chn  brt 	
	db	CUE_CMD,SET_BRT, 0x00, ITS, LIT		; IT'S
	db	CUE_CMD,SET_BRT, 0x00, HALF, LIT	; HALF
	db	CUE_CMD,SET_BRT, 0x00, TEN_, 0		; TEN_
	db	CUE_CMD,SET_BRT, 0x00, QUARTER, 0	; QUARTER
	db	CUE_CMD,SET_BRT, 0x00, TWENTY, 0	; TWENTY
	db	CUE_CMD,SET_BRT, 0x00, FIVE_, 0		; FIVE
	db	CUE_CMD,SET_BRT, 0x00, MINUTES, 0	; MINUTES
	db	CUE_CMD,SET_BRT, 0x00, PAST, LIT	; PAST
	db	CUE_CMD,SET_BRT, 0x00, TO_, 0		; TO_
	db	CUE_CMD,SET_BRT, 0x00, OCLOCK, 0	; O'CLOCK
;	db	CUE_CMD,WATCH,0x00,NEVER
	db	CUE_DONE

CUE_MINUTES_35
; SET_BRT 	CUE_CMD SET_BRT  mask  chn  brt 	
	db	CUE_CMD,SET_BRT, 0x00, ITS, LIT		; IT'S
	db	CUE_CMD,SET_BRT, 0x00, HALF, 0		; HALF
	db	CUE_CMD,SET_BRT, 0x00, TEN_, 0		; TEN_
	db	CUE_CMD,SET_BRT, 0x00, QUARTER, 0	; QUARTER
	db	CUE_CMD,SET_BRT, 0x00, TWENTY, LIT	; TWENTY
	db	CUE_CMD,SET_BRT, 0x00, FIVE_, LIT	; FIVE
	db	CUE_CMD,SET_BRT, 0x00, MINUTES, 0	; MINUTES
	db	CUE_CMD,SET_BRT, 0x00, PAST, 0		; PAST
	db	CUE_CMD,SET_BRT, 0x00, TO_, LIT		; TO_
	db	CUE_CMD,SET_BRT, 0x00, OCLOCK, 0	; O'CLOCK
;	db	CUE_CMD,WATCH,0x00,NEVER
	db	CUE_DONE

CUE_MINUTES_40
; SET_BRT 	CUE_CMD SET_BRT  mask  chn  brt 	
	db	CUE_CMD,SET_BRT, 0x00, ITS, LIT		; IT'S
	db	CUE_CMD,SET_BRT, 0x00, HALF, 0		; HALF
	db	CUE_CMD,SET_BRT, 0x00, TEN_, 0		; TEN_
	db	CUE_CMD,SET_BRT, 0x00, QUARTER, 0	; QUARTER
	db	CUE_CMD,SET_BRT, 0x00, TWENTY, LIT	; TWENTY
	db	CUE_CMD,SET_BRT, 0x00, FIVE_, 0		; FIVE
	db	CUE_CMD,SET_BRT, 0x00, MINUTES, LIT	; MINUTES
	db	CUE_CMD,SET_BRT, 0x00, PAST, 0		; PAST
	db	CUE_CMD,SET_BRT, 0x00, TO_, LIT		; TO_
	db	CUE_CMD,SET_BRT, 0x00, OCLOCK, 0	; O'CLOCK
;	db	CUE_CMD,WATCH,0x00,NEVER
	db	CUE_DONE

CUE_MINUTES_45
; SET_BRT 	CUE_CMD SET_BRT  mask  chn  brt 	
	db	CUE_CMD,SET_BRT, 0x00, ITS, LIT		; IT'S
	db	CUE_CMD,SET_BRT, 0x00, HALF, 0		; HALF
	db	CUE_CMD,SET_BRT, 0x00, TEN_, 0		; TEN_
	db	CUE_CMD,SET_BRT, 0x00, QUARTER, LIT	; QUARTER
	db	CUE_CMD,SET_BRT, 0x00, TWENTY, 0	; TWENTY
	db	CUE_CMD,SET_BRT, 0x00, FIVE_, 0		; FIVE
	db	CUE_CMD,SET_BRT, 0x00, MINUTES, 0	; MINUTES
	db	CUE_CMD,SET_BRT, 0x00, PAST, 0		; PAST
	db	CUE_CMD,SET_BRT, 0x00, TO_, LIT		; TO_
	db	CUE_CMD,SET_BRT, 0x00, OCLOCK, 0	; O'CLOCK
;	db	CUE_CMD,WATCH,0x00,NEVER
	db	CUE_DONE

CUE_MINUTES_50
; SET_BRT 	CUE_CMD SET_BRT  mask  chn  brt 	
	db	CUE_CMD,SET_BRT, 0x00, ITS, LIT		; IT'S
	db	CUE_CMD,SET_BRT, 0x00, HALF, 0		; HALF
	db	CUE_CMD,SET_BRT, 0x00, TEN_, LIT	; TEN_
	db	CUE_CMD,SET_BRT, 0x00, QUARTER, 0	; QUARTER
	db	CUE_CMD,SET_BRT, 0x00, TWENTY, 0	; TWENTY
	db	CUE_CMD,SET_BRT, 0x00, FIVE_, 0		; FIVE
	db	CUE_CMD,SET_BRT, 0x00, MINUTES, LIT	; MINUTES
	db	CUE_CMD,SET_BRT, 0x00, PAST, 0		; PAST
	db	CUE_CMD,SET_BRT, 0x00, TO_, LIT		; TO_
	db	CUE_CMD,SET_BRT, 0x00, OCLOCK, 0	; O'CLOCK
;	db	CUE_CMD,WATCH,0x00,NEVER
	db	CUE_DONE

CUE_MINUTES_55
; SET_BRT 	CUE_CMD SET_BRT  mask  chn  brt 	
	db	CUE_CMD,SET_BRT, 0x00, ITS, LIT		; IT'S
	db	CUE_CMD,SET_BRT, 0x00, HALF, 0		; HALF
	db	CUE_CMD,SET_BRT, 0x00, TEN_, 0		; TEN_
	db	CUE_CMD,SET_BRT, 0x00, QUARTER, 0	; QUARTER
	db	CUE_CMD,SET_BRT, 0x00, TWENTY, 0	; TWENTY
	db	CUE_CMD,SET_BRT, 0x00, FIVE_, LIT	; FIVE
	db	CUE_CMD,SET_BRT, 0x00, MINUTES, LIT	; MINUTES
	db	CUE_CMD,SET_BRT, 0x00, PAST, 0		; PAST
	db	CUE_CMD,SET_BRT, 0x00, TO_, LIT		; TO_
	db	CUE_CMD,SET_BRT, 0x00, OCLOCK, 0	; O'CLOCK
;	db	CUE_CMD,WATCH,0x00,NEVER
	db	CUE_DONE

; FADE_X	CUE_CMD FADE_X mask channel s,w,u,d,d,o,r,min, max, xfade
;	db	CUE_CMD,FADE_X,0,0, ITS,    1,0,0,0,0,0,1,XMAX,XMAX,XFADE
;	db	CUE_CMD,WATCH,0x00,NEVER
;	db	CUE_DONE

CUE_HOURS_OFF
; SET_BRT 	CUE_CMD SET_BRT  mask  chn  brt 	
	db	CUE_CMD,SET_BRT, 0x00, ONE, 0		; ONE
	db	CUE_CMD,SET_BRT, 0x00, TWO, 0		; TWO
	db	CUE_CMD,SET_BRT, 0x00, THREE, 0		; THREE
	db	CUE_CMD,SET_BRT, 0x00, FOUR, 0		; FOUR
	db	CUE_CMD,SET_BRT, 0x00, FIVE, 0		; FIVE
	db	CUE_CMD,SET_BRT, 0x00, SIX, 0		; SIX
	db	CUE_CMD,SET_BRT, 0x00, SEVEN, 0		; SEVEN
	db	CUE_CMD,SET_BRT, 0x00, EIGHT, 0		; EIGHT
	db	CUE_CMD,SET_BRT, 0x00, NINE, 0		; NiNE
	db	CUE_CMD,SET_BRT, 0x00, TEN, 0		; TEN_
	db	CUE_CMD,SET_BRT, 0x00, ELEVEN, 0	; ELEVEN
	db	CUE_CMD,SET_BRT, 0x00, TWELVE, 0	; TWELVE
;	db	CUE_CMD,WATCH,0x00,NEVER
	db	CUE_DONE

CUE_HOURS_01
; SET_BRT 	CUE_CMD SET_BRT  mask  chn  brt 	
	db	CUE_CMD,SET_BRT, 0x00, ONE, LIT		; ONE
	db	CUE_CMD,SET_BRT, 0x00, TWO, 0		; TWO
	db	CUE_CMD,SET_BRT, 0x00, THREE, 0		; THREE
	db	CUE_CMD,SET_BRT, 0x00, FOUR, 0		; FOUR
	db	CUE_CMD,SET_BRT, 0x00, FIVE, 0		; FIVE
	db	CUE_CMD,SET_BRT, 0x00, SIX, 0		; SIX
	db	CUE_CMD,SET_BRT, 0x00, SEVEN, 0		; SEVEN
	db	CUE_CMD,SET_BRT, 0x00, EIGHT, 0		; EIGHT
	db	CUE_CMD,SET_BRT, 0x00, NINE, 0		; NiNE
	db	CUE_CMD,SET_BRT, 0x00, TEN, 0		; TEN_
	db	CUE_CMD,SET_BRT, 0x00, ELEVEN, 0	; ELEVEN
	db	CUE_CMD,SET_BRT, 0x00, TWELVE, 0	; TWELVE
;	db	CUE_CMD,WATCH,0x00,NEVER
	db	CUE_DONE

CUE_HOURS_02
; SET_BRT 	CUE_CMD SET_BRT  mask  chn  brt 	
	db	CUE_CMD,SET_BRT, 0x00, ONE, 0		; ONE
	db	CUE_CMD,SET_BRT, 0x00, TWO, LIT		; TWO
	db	CUE_CMD,SET_BRT, 0x00, THREE, 0		; THREE
	db	CUE_CMD,SET_BRT, 0x00, FOUR, 0		; FOUR
	db	CUE_CMD,SET_BRT, 0x00, FIVE, 0		; FIVE
	db	CUE_CMD,SET_BRT, 0x00, SIX, 0		; SIX
	db	CUE_CMD,SET_BRT, 0x00, SEVEN, 0		; SEVEN
	db	CUE_CMD,SET_BRT, 0x00, EIGHT, 0		; EIGHT
	db	CUE_CMD,SET_BRT, 0x00, NINE, 0		; NiNE
	db	CUE_CMD,SET_BRT, 0x00, TEN, 0		; TEN_
	db	CUE_CMD,SET_BRT, 0x00, ELEVEN, 0	; ELEVEN
	db	CUE_CMD,SET_BRT, 0x00, TWELVE, 0	; TWELVE
;	db	CUE_CMD,WATCH,0x00,NEVER
	db	CUE_DONE

CUE_HOURS_03
; SET_BRT 	CUE_CMD SET_BRT  mask  chn  brt 	
	db	CUE_CMD,SET_BRT, 0x00, ONE, 0		; ONE
	db	CUE_CMD,SET_BRT, 0x00, TWO, 0		; TWO
	db	CUE_CMD,SET_BRT, 0x00, THREE, LIT	; THREE
	db	CUE_CMD,SET_BRT, 0x00, FOUR, 0		; FOUR
	db	CUE_CMD,SET_BRT, 0x00, FIVE, 0		; FIVE
	db	CUE_CMD,SET_BRT, 0x00, SIX, 0		; SIX
	db	CUE_CMD,SET_BRT, 0x00, SEVEN, 0		; SEVEN
	db	CUE_CMD,SET_BRT, 0x00, EIGHT, 0		; EIGHT
	db	CUE_CMD,SET_BRT, 0x00, NINE, 0		; NiNE
	db	CUE_CMD,SET_BRT, 0x00, TEN, 0		; TEN_
	db	CUE_CMD,SET_BRT, 0x00, ELEVEN, 0	; ELEVEN
	db	CUE_CMD,SET_BRT, 0x00, TWELVE, 0	; TWELVE
;	db	CUE_CMD,WATCH,0x00,NEVER
	db	CUE_DONE

CUE_HOURS_04
; SET_BRT 	CUE_CMD SET_BRT  mask  chn  brt 	
	db	CUE_CMD,SET_BRT, 0x00, ONE, 0		; ONE
	db	CUE_CMD,SET_BRT, 0x00, TWO, 0		; TWO
	db	CUE_CMD,SET_BRT, 0x00, THREE, 0		; THREE
	db	CUE_CMD,SET_BRT, 0x00, FOUR, LIT	; FOUR
	db	CUE_CMD,SET_BRT, 0x00, FIVE, 0		; FIVE
	db	CUE_CMD,SET_BRT, 0x00, SIX, 0		; SIX
	db	CUE_CMD,SET_BRT, 0x00, SEVEN, 0		; SEVEN
	db	CUE_CMD,SET_BRT, 0x00, EIGHT, 0		; EIGHT
	db	CUE_CMD,SET_BRT, 0x00, NINE, 0		; NiNE
	db	CUE_CMD,SET_BRT, 0x00, TEN, 0		; TEN
	db	CUE_CMD,SET_BRT, 0x00, ELEVEN, 0	; ELEVEN
	db	CUE_CMD,SET_BRT, 0x00, TWELVE, 0	; TWELVE
;	db	CUE_CMD,WATCH,0x00,NEVER
	db	CUE_DONE

CUE_HOURS_05
; SET_BRT 	CUE_CMD SET_BRT  mask  chn  brt 	
	db	CUE_CMD,SET_BRT, 0x00, ONE, 0		; ONE
	db	CUE_CMD,SET_BRT, 0x00, TWO, 0		; TWO
	db	CUE_CMD,SET_BRT, 0x00, THREE, 0		; THREE
	db	CUE_CMD,SET_BRT, 0x00, FOUR, 0		; FOUR
	db	CUE_CMD,SET_BRT, 0x00, FIVE, LIT	; FIVE
	db	CUE_CMD,SET_BRT, 0x00, SIX, 0		; SIX
	db	CUE_CMD,SET_BRT, 0x00, SEVEN, 0		; SEVEN
	db	CUE_CMD,SET_BRT, 0x00, EIGHT, 0		; EIGHT
	db	CUE_CMD,SET_BRT, 0x00, NINE, 0		; NiNE
	db	CUE_CMD,SET_BRT, 0x00, TEN, 0		; TEN
	db	CUE_CMD,SET_BRT, 0x00, ELEVEN, 0	; ELEVEN
	db	CUE_CMD,SET_BRT, 0x00, TWELVE, 0	; TWELVE
;	db	CUE_CMD,WATCH,0x00,NEVER
	db	CUE_DONE

CUE_HOURS_06
; SET_BRT 	CUE_CMD SET_BRT  mask  chn  brt 	
	db	CUE_CMD,SET_BRT, 0x00, ONE, 0		; ONE
	db	CUE_CMD,SET_BRT, 0x00, TWO, 0		; TWO
	db	CUE_CMD,SET_BRT, 0x00, THREE, 0		; THREE
	db	CUE_CMD,SET_BRT, 0x00, FOUR, 0		; FOUR
	db	CUE_CMD,SET_BRT, 0x00, FIVE, 0		; FIVE
	db	CUE_CMD,SET_BRT, 0x00, SIX, LIT		; SIX
	db	CUE_CMD,SET_BRT, 0x00, SEVEN, 0		; SEVEN
	db	CUE_CMD,SET_BRT, 0x00, EIGHT, 0		; EIGHT
	db	CUE_CMD,SET_BRT, 0x00, NINE, 0		; NiNE
	db	CUE_CMD,SET_BRT, 0x00, TEN, 0		; TEN
	db	CUE_CMD,SET_BRT, 0x00, ELEVEN, 0	; ELEVEN
	db	CUE_CMD,SET_BRT, 0x00, TWELVE, 0	; TWELVE
;	db	CUE_CMD,WATCH,0x00,NEVER
	db	CUE_DONE

CUE_HOURS_07
; SET_BRT 	CUE_CMD SET_BRT  mask  chn  brt 	
	db	CUE_CMD,SET_BRT, 0x00, ONE, 0		; ONE
	db	CUE_CMD,SET_BRT, 0x00, TWO, 0		; TWO
	db	CUE_CMD,SET_BRT, 0x00, THREE, 0		; THREE
	db	CUE_CMD,SET_BRT, 0x00, FOUR, 0		; FOUR
	db	CUE_CMD,SET_BRT, 0x00, FIVE, 0		; FIVE
	db	CUE_CMD,SET_BRT, 0x00, SIX, 0		; SIX
	db	CUE_CMD,SET_BRT, 0x00, SEVEN, LIT	; SEVEN
	db	CUE_CMD,SET_BRT, 0x00, EIGHT, 0		; EIGHT
	db	CUE_CMD,SET_BRT, 0x00, NINE, 0		; NiNE
	db	CUE_CMD,SET_BRT, 0x00, TEN, 0		; TEN
	db	CUE_CMD,SET_BRT, 0x00, ELEVEN, 0	; ELEVEN
	db	CUE_CMD,SET_BRT, 0x00, TWELVE, 0	; TWELVE
;	db	CUE_CMD,WATCH,0x00,NEVER
	db	CUE_DONE

CUE_HOURS_08
; SET_BRT 	CUE_CMD SET_BRT  mask  chn  brt 	
	db	CUE_CMD,SET_BRT, 0x00, ONE, 0		; ONE
	db	CUE_CMD,SET_BRT, 0x00, TWO, 0		; TWO
	db	CUE_CMD,SET_BRT, 0x00, THREE, 0		; THREE
	db	CUE_CMD,SET_BRT, 0x00, FOUR, 0		; FOUR
	db	CUE_CMD,SET_BRT, 0x00, FIVE, 0		; FIVE
	db	CUE_CMD,SET_BRT, 0x00, SIX, 0		; SIX
	db	CUE_CMD,SET_BRT, 0x00, SEVEN, 0		; SEVEN
	db	CUE_CMD,SET_BRT, 0x00, EIGHT, LIT	; EIGHT
	db	CUE_CMD,SET_BRT, 0x00, NINE, 0		; NiNE
	db	CUE_CMD,SET_BRT, 0x00, TEN, 0		; TEN
	db	CUE_CMD,SET_BRT, 0x00, ELEVEN, 0	; ELEVEN
	db	CUE_CMD,SET_BRT, 0x00, TWELVE, 0	; TWELVE
;	db	CUE_CMD,WATCH,0x00,NEVER
	db	CUE_DONE

CUE_HOURS_09
; SET_BRT 	CUE_CMD SET_BRT  mask  chn  brt 	
	db	CUE_CMD,SET_BRT, 0x00, ONE, 0		; ONE
	db	CUE_CMD,SET_BRT, 0x00, TWO, 0		; TWO
	db	CUE_CMD,SET_BRT, 0x00, THREE, 0		; THREE
	db	CUE_CMD,SET_BRT, 0x00, FOUR, 0		; FOUR
	db	CUE_CMD,SET_BRT, 0x00, FIVE, 0		; FIVE
	db	CUE_CMD,SET_BRT, 0x00, SIX, 0		; SIX
	db	CUE_CMD,SET_BRT, 0x00, SEVEN, 0		; SEVEN
	db	CUE_CMD,SET_BRT, 0x00, EIGHT, 0		; EIGHT
	db	CUE_CMD,SET_BRT, 0x00, NINE, LIT	; NiNE
	db	CUE_CMD,SET_BRT, 0x00, TEN, 0		; TEN
	db	CUE_CMD,SET_BRT, 0x00, ELEVEN, 0	; ELEVEN
	db	CUE_CMD,SET_BRT, 0x00, TWELVE, 0	; TWELVE
;	db	CUE_CMD,WATCH,0x00,NEVER
	db	CUE_DONE

CUE_HOURS_10
; SET_BRT 	CUE_CMD SET_BRT  mask  chn  brt 	
	db	CUE_CMD,SET_BRT, 0x00, ONE, 0		; ONE
	db	CUE_CMD,SET_BRT, 0x00, TWO, 0		; TWO
	db	CUE_CMD,SET_BRT, 0x00, THREE, 0		; THREE
	db	CUE_CMD,SET_BRT, 0x00, FOUR, 0		; FOUR
	db	CUE_CMD,SET_BRT, 0x00, FIVE, 0		; FIVE
	db	CUE_CMD,SET_BRT, 0x00, SIX, 0		; SIX
	db	CUE_CMD,SET_BRT, 0x00, SEVEN, 0		; SEVEN
	db	CUE_CMD,SET_BRT, 0x00, EIGHT, 0		; EIGHT
	db	CUE_CMD,SET_BRT, 0x00, NINE, 0		; NiNE
	db	CUE_CMD,SET_BRT, 0x00, TEN, LIT		; TEN
	db	CUE_CMD,SET_BRT, 0x00, ELEVEN, 0	; ELEVEN
	db	CUE_CMD,SET_BRT, 0x00, TWELVE, 0	; TWELVE
;	db	CUE_CMD,WATCH,0x00,NEVER
	db	CUE_DONE

CUE_HOURS_11
; SET_BRT 	CUE_CMD SET_BRT  mask  chn  brt 	
	db	CUE_CMD,SET_BRT, 0x00, ONE, 0		; ONE
	db	CUE_CMD,SET_BRT, 0x00, TWO, 0		; TWO
	db	CUE_CMD,SET_BRT, 0x00, THREE, 0		; THREE
	db	CUE_CMD,SET_BRT, 0x00, FOUR, 0		; FOUR
	db	CUE_CMD,SET_BRT, 0x00, FIVE, 0		; FIVE
	db	CUE_CMD,SET_BRT, 0x00, SIX, 0		; SIX
	db	CUE_CMD,SET_BRT, 0x00, SEVEN, 0		; SEVEN
	db	CUE_CMD,SET_BRT, 0x00, EIGHT, 0		; EIGHT
	db	CUE_CMD,SET_BRT, 0x00, NINE, 0		; NiNE
	db	CUE_CMD,SET_BRT, 0x00, TEN, 0		; TEN
	db	CUE_CMD,SET_BRT, 0x00, ELEVEN, LIT	; ELEVEN
	db	CUE_CMD,SET_BRT, 0x00, TWELVE, 0	; TWELVE
;	db	CUE_CMD,WATCH,0x00,NEVER
	db	CUE_DONE

CUE_HOURS_12
; SET_BRT 	CUE_CMD SET_BRT  mask  chn  brt 	
	db	CUE_CMD,SET_BRT, 0x00, ONE, 0		; ONE
	db	CUE_CMD,SET_BRT, 0x00, TWO, 0		; TWO
	db	CUE_CMD,SET_BRT, 0x00, THREE, 0		; THREE
	db	CUE_CMD,SET_BRT, 0x00, FOUR, 0		; FOUR
	db	CUE_CMD,SET_BRT, 0x00, FIVE, 0		; FIVE
	db	CUE_CMD,SET_BRT, 0x00, SIX, 0		; SIX
	db	CUE_CMD,SET_BRT, 0x00, SEVEN, 0		; SEVEN
	db	CUE_CMD,SET_BRT, 0x00, EIGHT, 0		; EIGHT
	db	CUE_CMD,SET_BRT, 0x00, NINE, 0		; NiNE
	db	CUE_CMD,SET_BRT, 0x00, TEN, 0		; TEN
	db	CUE_CMD,SET_BRT, 0x00, ELEVEN, 0	; ELEVEN
	db	CUE_CMD,SET_BRT, 0x00, TWELVE, LIT	; TWELVE
;	db	CUE_CMD,WATCH,0x00,NEVER
	db	CUE_DONE

; FADE_X	CUE_CMD FADE_X mask channel s,w,u,d,d,o,r,min, max, xfade
;	db	CUE_CMD,FADE_X,0,0, ITS,    1,0,0,0,0,0,1,XMAX,XMAX,XFADE
;	db	CUE_CMD,WATCH,0x00,NEVER
;	db	CUE_DONE

   if FALSE
CUE_PLUS_0
	db	CUE_CMD,SET_BRT, 0x00, .22, 0		; PLUS 1
	db	CUE_CMD,SET_BRT, 0x00, .23, 0		; PLUS 2
	db	CUE_CMD,SET_BRT, 0x00, .24, 0		; PLUS 3
	db	CUE_CMD,SET_BRT, 0x00, .25, 0		; PLUS 4
;	db	CUE_CMD,WATCH,0x00,NEVER
	db	CUE_DONE

CUE_PLUS_1
	db	CUE_CMD,SET_BRT, 0x00, .22, LIT		; PLUS 1
	db	CUE_CMD,SET_BRT, 0x00, .23, 0		; PLUS 2
	db	CUE_CMD,SET_BRT, 0x00, .24, 0		; PLUS 3
	db	CUE_CMD,SET_BRT, 0x00, .25, 0		; PLUS 4
;	db	CUE_CMD,WATCH,0x00,NEVER
	db	CUE_DONE

CUE_PLUS_2
	db	CUE_CMD,SET_BRT, 0x00, .22, LIT		; PLUS 1
	db	CUE_CMD,SET_BRT, 0x00, .23, LIT		; PLUS 2
	db	CUE_CMD,SET_BRT, 0x00, .24, 0		; PLUS 3
	db	CUE_CMD,SET_BRT, 0x00, .25, 0		; PLUS 4
;	db	CUE_CMD,WATCH,0x00,NEVER
	db	CUE_DONE

CUE_PLUS_3
	db	CUE_CMD,SET_BRT, 0x00, .22, LIT		; PLUS 1
	db	CUE_CMD,SET_BRT, 0x00, .23, LIT		; PLUS 2
	db	CUE_CMD,SET_BRT, 0x00, .24, LIT		; PLUS 3
	db	CUE_CMD,SET_BRT, 0x00, .25, 0		; PLUS 4
;	db	CUE_CMD,WATCH,0x00,NEVER
	db	CUE_DONE

CUE_PLUS_4
	db	CUE_CMD,SET_BRT, 0x00, .22, LIT		; PLUS 1
	db	CUE_CMD,SET_BRT, 0x00, .23, LIT		; PLUS 2
	db	CUE_CMD,SET_BRT, 0x00, .24, LIT		; PLUS 3
	db	CUE_CMD,SET_BRT, 0x00, .25, LIT		; PLUS 4
;	db	CUE_CMD,WATCH,0x00,NEVER
	db	CUE_DONE

    endif

CUE_ALL_DIM
; SET_BRT 	CUE_CMD SET_BRT  mask  chn  brt 	
	db	CUE_CMD,SET_BRT, 0x00, ITS, DIM		; IT'S
	db	CUE_CMD,SET_BRT, 0x00, HALF, DIM	; HALF
	db	CUE_CMD,SET_BRT, 0x00, TEN_, DIM	; TEN_
	db	CUE_CMD,SET_BRT, 0x00, QUARTER, DIM	; QUARTER
	db	CUE_CMD,SET_BRT, 0x00, TWENTY, DIM	; TWENTY
	db	CUE_CMD,SET_BRT, 0x00, FIVE_, DIM	; FIVE
	db	CUE_CMD,SET_BRT, 0x00, MINUTES, DIM	; MINUTES
	db	CUE_CMD,SET_BRT, 0x00, PAST, DIM	; PAST
	db	CUE_CMD,SET_BRT, 0x00, TO_, DIM		; TO_
	db	CUE_CMD,SET_BRT, 0x00, ONE, DIM		; ONE
	db	CUE_CMD,SET_BRT, 0x00, TWO, DIM		; TWO
	db	CUE_CMD,SET_BRT, 0x00, THREE, DIM	; THREE
	db	CUE_CMD,SET_BRT, 0x00, FOUR, DIM	; FOUR
	db	CUE_CMD,SET_BRT, 0x00, FIVE, DIM	; FIVE
	db	CUE_CMD,SET_BRT, 0x00, SIX, DIM		; SIX
	db	CUE_CMD,SET_BRT, 0x00, SEVEN, DIM	; SEVEN
	db	CUE_CMD,SET_BRT, 0x00, EIGHT, DIM	; EIGHT
	db	CUE_CMD,SET_BRT, 0x00, NINE, DIM	; NiNE
	db	CUE_CMD,SET_BRT, 0x00, TEN, DIM		; TEN_
	db	CUE_CMD,SET_BRT, 0x00, ELEVEN, DIM	; ELEVEN
	db	CUE_CMD,SET_BRT, 0x00, TWELVE, DIM	; TWELVE
	db	CUE_CMD,SET_BRT, 0x00, OCLOCK, DIM	; O'CLOCK
;	db	CUE_CMD,SET_BRT, 0x00, .22, DIM		; PLUS 1
;	db	CUE_CMD,SET_BRT, 0x00, .23, DIM		; PLUS 2
;	db	CUE_CMD,SET_BRT, 0x00, .24, DIM		; PLUS 3
;	db	CUE_CMD,SET_BRT, 0x00, .25, DIM		; PLUS 4
;	db	CUE_CMD,WATCH,0x00,NEVER
	db	CUE_DONE

CUE_PANIC
; SET_BRT 	CUE_CMD SET_BRT  mask  chn  brt 	
	db	CUE_CMD,SET_BRT, 0x00, ITS, LIT		; IT'S
	db	CUE_CMD,SET_BRT, 0x00, HALF, 0		; HALF
	db	CUE_CMD,SET_BRT, 0x00, TEN_, LIT	; TEN_
	db	CUE_CMD,SET_BRT, 0x00, QUARTER, 0	; QUARTER
	db	CUE_CMD,SET_BRT, 0x00, TWENTY, LIT	; TWENTY
	db	CUE_CMD,SET_BRT, 0x00, FIVE_, 0 	; FIVE
	db	CUE_CMD,SET_BRT, 0x00, MINUTES, LIT	; MINUTES
	db	CUE_CMD,SET_BRT, 0x00, PAST, 0		; PAST
	db	CUE_CMD,SET_BRT, 0x00, TO_, LIT		; TO_
	db	CUE_CMD,SET_BRT, 0x00, ONE, 0		; ONE
	db	CUE_CMD,SET_BRT, 0x00, TWO, LIT		; TWO
	db	CUE_CMD,SET_BRT, 0x00, THREE, 0		; THREE
	db	CUE_CMD,SET_BRT, 0x00, FOUR, LIT	; FOUR
	db	CUE_CMD,SET_BRT, 0x00, FIVE, 0		; FIVE
	db	CUE_CMD,SET_BRT, 0x00, SIX, LIT		; SIX
	db	CUE_CMD,SET_BRT, 0x00, SEVEN, 0		; SEVEN
	db	CUE_CMD,SET_BRT, 0x00, EIGHT, LIT	; EIGHT
	db	CUE_CMD,SET_BRT, 0x00, NINE, 0		; NiNE
	db	CUE_CMD,SET_BRT, 0x00, TEN, LIT		; TEN_
	db	CUE_CMD,SET_BRT, 0x00, ELEVEN, 0	; ELEVEN
	db	CUE_CMD,SET_BRT, 0x00, TWELVE, LIT	; TWELVE
	db	CUE_CMD,SET_BRT, 0x00, OCLOCK, 0	; O'CLOCK
;	db	CUE_CMD,SET_BRT, 0x00, .22, 0		; PLUS 1
;	db	CUE_CMD,SET_BRT, 0x00, .23, DIM		; PLUS 2
;	db	CUE_CMD,SET_BRT, 0x00, .24, DIM		; PLUS 3
;	db	CUE_CMD,SET_BRT, 0x00, .25, DIM		; PLUS 4
;	db	CUE_CMD,WATCH,0x00,NEVER
	db	CUE_DONE

CUE_ALL_OFF
; SET_BRT 	CUE_CMD SET_BRT  mask  chn  brt 	
	db	CUE_CMD,SET_BRT, 0x00, ITS, 0		; IT'S
	db	CUE_CMD,SET_BRT, 0x00, HALF, 0		; HALF
	db	CUE_CMD,SET_BRT, 0x00, TEN_, 0		; TEN_
	db	CUE_CMD,SET_BRT, 0x00, QUARTER, 0	; QUARTER
	db	CUE_CMD,SET_BRT, 0x00, TWENTY, 0	; TWENTY
	db	CUE_CMD,SET_BRT, 0x00, FIVE_, 0		; FIVE
	db	CUE_CMD,SET_BRT, 0x00, MINUTES, 0	; MINUTES
	db	CUE_CMD,SET_BRT, 0x00, PAST, 0		; PAST
	db	CUE_CMD,SET_BRT, 0x00, TO_, 0		; TO_
	db	CUE_CMD,SET_BRT, 0x00, ONE, 0		; ONE
	db	CUE_CMD,SET_BRT, 0x00, TWO, 0		; TWO
	db	CUE_CMD,SET_BRT, 0x00, THREE, 0		; THREE
	db	CUE_CMD,SET_BRT, 0x00, FOUR, 0		; FOUR
	db	CUE_CMD,SET_BRT, 0x00, FIVE, 0		; FIVE
	db	CUE_CMD,SET_BRT, 0x00, SIX, 0		; SIX
	db	CUE_CMD,SET_BRT, 0x00, SEVEN, 0		; SEVEN
	db	CUE_CMD,SET_BRT, 0x00, EIGHT, 0		; EIGHT
	db	CUE_CMD,SET_BRT, 0x00, NINE, 0		; NiNE
	db	CUE_CMD,SET_BRT, 0x00, TEN, 0		; TEN_
	db	CUE_CMD,SET_BRT, 0x00, ELEVEN, 0	; ELEVEN
	db	CUE_CMD,SET_BRT, 0x00, TWELVE, 0	; TWELVE
	db	CUE_CMD,SET_BRT, 0x00, OCLOCK, 0	; O'CLOCK
;	db	CUE_CMD,SET_BRT, 0x00, .22, 0		; PLUS 1
;	db	CUE_CMD,SET_BRT, 0x00, .23, 0		; PLUS 2
;	db	CUE_CMD,SET_BRT, 0x00, .24, 0		; PLUS 3
;	db	CUE_CMD,SET_BRT, 0x00, .25, 0		; PLUS 4
;	db	CUE_CMD,WATCH,0x00,NEVER
	db	CUE_DONE

CUE_ALL_ON
; SET_BRT 	CUE_CMD SET_BRT  mask  chn  brt 	
	db	CUE_CMD,SET_BRT, 0x00, ITS, LIT
	db	CUE_CMD,SET_BRT, 0x00, HALF, LIT
	db	CUE_CMD,SET_BRT, 0x00, TEN_, LIT
	db	CUE_CMD,SET_BRT, 0x00, QUARTER, LIT
	db	CUE_CMD,SET_BRT, 0x00, TWENTY, LIT
	db	CUE_CMD,SET_BRT, 0x00, FIVE_, LIT
	db	CUE_CMD,SET_BRT, 0x00, MINUTES, LIT
	db	CUE_CMD,SET_BRT, 0x00, PAST, LIT
	db	CUE_CMD,SET_BRT, 0x00, TO_, LIT
	db	CUE_CMD,SET_BRT, 0x00, ONE, LIT
	db	CUE_CMD,SET_BRT, 0x00, TWO, LIT
	db	CUE_CMD,SET_BRT, 0x00, THREE, LIT
	db	CUE_CMD,SET_BRT, 0x00, FOUR, LIT
	db	CUE_CMD,SET_BRT, 0x00, FIVE, LIT
	db	CUE_CMD,SET_BRT, 0x00, SIX, LIT
	db	CUE_CMD,SET_BRT, 0x00, SEVEN, LIT
	db	CUE_CMD,SET_BRT, 0x00, EIGHT, LIT
	db	CUE_CMD,SET_BRT, 0x00, NINE, LIT
	db	CUE_CMD,SET_BRT, 0x00, TEN, LIT
	db	CUE_CMD,SET_BRT, 0x00, ELEVEN, LIT
	db	CUE_CMD,SET_BRT, 0x00, TWELVE, LIT
	db	CUE_CMD,SET_BRT, 0x00, OCLOCK, LIT
;	db	CUE_CMD,SET_BRT, 0x00, .22, LIT
;	db	CUE_CMD,SET_BRT, 0x00, .23, LIT
;	db	CUE_CMD,SET_BRT, 0x00, .24, LIT
;	db	CUE_CMD,SET_BRT, 0x00, .25, LIT
	db	CUE_CMD,WATCH,0x00,NEVER
	db	CUE_DONE

    if FALSE

CUE_PORTA_ON
; SET_BRT 	CUE_CMD SET_BRT  mask  chn  brt 	
	db	CUE_CMD,SET_BRT, 0x00, ITS, LIT		; IT'S
	db	CUE_CMD,SET_BRT, 0x00, TWO, LIT		; TWO
	db	CUE_CMD,SET_BRT, 0x00, SIX, LIT		; SIX
	db	CUE_CMD,SET_BRT, 0x00, SEVEN, LIT		; SEVEN
	db	CUE_CMD,SET_BRT, 0x00, TEN, LIT		; TEN
	db	CUE_CMD,SET_BRT, 0x00, ELEVEN, LIT		; ELEVEN

	db	CUE_CMD,SET_BRT, 0x00, HALF, 0		; HALF
	db	CUE_CMD,SET_BRT, 0x00, TEN_, 0		; TEN_
	db	CUE_CMD,SET_BRT, 0x00, QUARTER, 0		; QUARTER
	db	CUE_CMD,SET_BRT, 0x00, TWENTY, 0		; TWENTY
	db	CUE_CMD,SET_BRT, 0x00, FIVE_, 0		; FIVE
	db	CUE_CMD,SET_BRT, 0x00, MINUTES, 0		; MINUTES
	db	CUE_CMD,SET_BRT, 0x00, PAST, 0		; PAST
	db	CUE_CMD,SET_BRT, 0x00, TO_, 0		; TO_
	db	CUE_CMD,SET_BRT, 0x00, ONE, 0		; ONE
	db	CUE_CMD,SET_BRT, 0x00, THREE, 0		; THREE
	db	CUE_CMD,SET_BRT, 0x00, FOUR, 0		; FOUR
	db	CUE_CMD,SET_BRT, 0x00, FIVE, 0		; FIVE
	db	CUE_CMD,SET_BRT, 0x00, EIGHT, 0		; EIGHT
	db	CUE_CMD,SET_BRT, 0x00, NINE, 0		; NiNE
	db	CUE_CMD,SET_BRT, 0x00, TWELVE, 0		; TWELVE
	db	CUE_CMD,SET_BRT, 0x00, OCLOCK, 0		; O'CLOCK
	db	CUE_CMD,SET_BRT, 0x00, .22, 0		; PLUS 1
	db	CUE_CMD,SET_BRT, 0x00, .23, 0		; PLUS 2
	db	CUE_CMD,SET_BRT, 0x00, .24, 0		; PLUS 3
	db	CUE_CMD,SET_BRT, 0x00, .25, 0		; PLUS 4
;	db	CUE_CMD,WATCH,0x00,NEVER
	db	CUE_DONE

CUE_PORTB_ON
; SET_BRT 	CUE_CMD SET_BRT  mask  chn  brt 	
	db	CUE_CMD,SET_BRT, 0x00, TWELVE, LIT		; TWELVE
	db	CUE_CMD,SET_BRT, 0x00, OCLOCK, LIT		; O'CLOCK
	db	CUE_CMD,SET_BRT, 0x00, .22, LIT		; PLUS 1
	db	CUE_CMD,SET_BRT, 0x00, .23, LIT		; PLUS 2
	db	CUE_CMD,SET_BRT, 0x00, .24, LIT		; PLUS 3
	db	CUE_CMD,SET_BRT, 0x00, .25, LIT		; PLUS 4

	db	CUE_CMD,SET_BRT, 0x00, ITS, 0		; IT'S
	db	CUE_CMD,SET_BRT, 0x00, HALF, 0		; HALF
	db	CUE_CMD,SET_BRT, 0x00, TEN_, 0		; TEN_
	db	CUE_CMD,SET_BRT, 0x00, QUARTER, 0		; QUARTER
	db	CUE_CMD,SET_BRT, 0x00, TWENTY, 0		; TWENTY
	db	CUE_CMD,SET_BRT, 0x00, FIVE_, 0		; FIVE
	db	CUE_CMD,SET_BRT, 0x00, MINUTES, 0		; MINUTES
	db	CUE_CMD,SET_BRT, 0x00, PAST, 0		; PAST
	db	CUE_CMD,SET_BRT, 0x00, TO_, 0		; TO_
	db	CUE_CMD,SET_BRT, 0x00, ONE, 0		; ONE
	db	CUE_CMD,SET_BRT, 0x00, TWO, 0		; TWO
	db	CUE_CMD,SET_BRT, 0x00, THREE, 0		; THREE
	db	CUE_CMD,SET_BRT, 0x00, FOUR, 0		; FOUR
	db	CUE_CMD,SET_BRT, 0x00, FIVE, 0		; FIVE
	db	CUE_CMD,SET_BRT, 0x00, SIX, 0		; SIX
	db	CUE_CMD,SET_BRT, 0x00, SEVEN, 0		; SEVEN
	db	CUE_CMD,SET_BRT, 0x00, EIGHT, 0		; EIGHT
	db	CUE_CMD,SET_BRT, 0x00, NINE, 0		; NiNE
	db	CUE_CMD,SET_BRT, 0x00, TEN, 0		; TEN
	db	CUE_CMD,SET_BRT, 0x00, ELEVEN, 0		; ELEVEN
;	db	CUE_CMD,WATCH,0x00,NEVER
	db	CUE_DONE

CUE_PORTC_ON
; SET_BRT 	CUE_CMD SET_BRT  mask  chn  brt 	
	db	CUE_CMD,SET_BRT, 0x00, HALF, LIT		; HALF
	db	CUE_CMD,SET_BRT, 0x00, TWENTY, LIT		; TWENTY
	db	CUE_CMD,SET_BRT, 0x00, MINUTES, LIT		; MINUTES
	db	CUE_CMD,SET_BRT, 0x00, PAST, LIT		; PAST
	db	CUE_CMD,SET_BRT, 0x00, TO_, LIT		; TO_
	db	CUE_CMD,SET_BRT, 0x00, THREE, LIT		; THREE

	db	CUE_CMD,SET_BRT, 0x00, ITS, 0		; IT'S
	db	CUE_CMD,SET_BRT, 0x00, TEN_, 0		; TEN_
	db	CUE_CMD,SET_BRT, 0x00, QUARTER, 0		; QUARTER
	db	CUE_CMD,SET_BRT, 0x00, FIVE_, 0		; FIVE
	db	CUE_CMD,SET_BRT, 0x00, ONE, 0		; ONE
	db	CUE_CMD,SET_BRT, 0x00, TWO, 0		; TWO
	db	CUE_CMD,SET_BRT, 0x00, FOUR, 0		; FOUR
	db	CUE_CMD,SET_BRT, 0x00, FIVE, 0		; FIVE
	db	CUE_CMD,SET_BRT, 0x00, SIX, 0		; SIX
	db	CUE_CMD,SET_BRT, 0x00, SEVEN, 0		; SEVEN
	db	CUE_CMD,SET_BRT, 0x00, EIGHT, 0		; EIGHT
	db	CUE_CMD,SET_BRT, 0x00, NINE, 0		; NiNE
	db	CUE_CMD,SET_BRT, 0x00, TEN, 0		; TEN
	db	CUE_CMD,SET_BRT, 0x00, ELEVEN, 0		; ELEVEN
	db	CUE_CMD,SET_BRT, 0x00, TWELVE, 0		; TWELVE
	db	CUE_CMD,SET_BRT, 0x00, OCLOCK, 0		; O'CLOCK
	db	CUE_CMD,SET_BRT, 0x00, .22, 0		; PLUS 1
	db	CUE_CMD,SET_BRT, 0x00, .23, 0		; PLUS 2
	db	CUE_CMD,SET_BRT, 0x00, .24, 0		; PLUS 3
	db	CUE_CMD,SET_BRT, 0x00, .25, 0		; PLUS 4
;	db	CUE_CMD,WATCH,0x00,NEVER
	db	CUE_DONE

CUE_PORTD_ON
; SET_BRT 	CUE_CMD SET_BRT  mask  chn  brt 	
	db	CUE_CMD,SET_BRT, 0x00, TEN_, LIT		; TEN_
	db	CUE_CMD,SET_BRT, 0x00, QUARTER, LIT		; QUARTER
	db	CUE_CMD,SET_BRT, 0x00, FIVE_, LIT		; FIVE
	db	CUE_CMD,SET_BRT, 0x00, THREE, LIT		; THREE
	db	CUE_CMD,SET_BRT, 0x00, FOUR, LIT		; FOUR
	db	CUE_CMD,SET_BRT, 0x00, SEVEN, LIT		; SEVEN
	db	CUE_CMD,SET_BRT, 0x00, EIGHT, LIT		; EIGHT

	db	CUE_CMD,SET_BRT, 0x00, ITS, 0		; IT'S
	db	CUE_CMD,SET_BRT, 0x00, HALF, 0		; HALF
	db	CUE_CMD,SET_BRT, 0x00, TWENTY, 0		; TWENTY
	db	CUE_CMD,SET_BRT, 0x00, MINUTES, 0		; MINUTES
	db	CUE_CMD,SET_BRT, 0x00, PAST, 0		; PAST
	db	CUE_CMD,SET_BRT, 0x00, TO_, 0		; TO_
	db	CUE_CMD,SET_BRT, 0x00, ONE, 0		; ONE
	db	CUE_CMD,SET_BRT, 0x00, TWO, 0		; TWO
	db	CUE_CMD,SET_BRT, 0x00, FIVE, 0		; FIVE
	db	CUE_CMD,SET_BRT, 0x00, SIX, 0		; SIX
	db	CUE_CMD,SET_BRT, 0x00, NINE, 0		; NiNE
	db	CUE_CMD,SET_BRT, 0x00, TEN, 0		; TEN
	db	CUE_CMD,SET_BRT, 0x00, ELEVEN, 0		; ELEVEN
	db	CUE_CMD,SET_BRT, 0x00, TWELVE, 0		; TWELVE
	db	CUE_CMD,SET_BRT, 0x00, OCLOCK, 0		; O'CLOCK
	db	CUE_CMD,SET_BRT, 0x00, .22, 0		; PLUS 1
	db	CUE_CMD,SET_BRT, 0x00, .23, 0		; PLUS 2
	db	CUE_CMD,SET_BRT, 0x00, .24, 0		; PLUS 3
	db	CUE_CMD,SET_BRT, 0x00, .25, 0		; PLUS 4
;	db	CUE_CMD,WATCH,0x00,NEVER
	db	CUE_DONE

CUE_PORTE_ON
; SET_BRT 	CUE_CMD SET_BRT  mask  chn  brt 	
	db	CUE_CMD,SET_BRT, 0x00, ONE, LIT		; ONE
	db	CUE_CMD,SET_BRT, 0x00, FIVE, LIT		; FIVE
	db	CUE_CMD,SET_BRT, 0x00, NINE, LIT		; NiNE

	db	CUE_CMD,SET_BRT, 0x00, ITS, 0		; IT'S
	db	CUE_CMD,SET_BRT, 0x00, HALF, 0		; HALF
	db	CUE_CMD,SET_BRT, 0x00, TEN_, 0		; TEN_
	db	CUE_CMD,SET_BRT, 0x00, QUARTER, 0		; QUARTER
	db	CUE_CMD,SET_BRT, 0x00, TWENTY, 0		; TWENTY
	db	CUE_CMD,SET_BRT, 0x00, FIVE_, 0		; FIVE
	db	CUE_CMD,SET_BRT, 0x00, MINUTES, 0		; MINUTES
	db	CUE_CMD,SET_BRT, 0x00, PAST, 0		; PAST
	db	CUE_CMD,SET_BRT, 0x00, TO_, 0		; TO_
	db	CUE_CMD,SET_BRT, 0x00, TWO, 0		; TWO
	db	CUE_CMD,SET_BRT, 0x00, THREE, 0		; THREE
	db	CUE_CMD,SET_BRT, 0x00, FOUR, 0		; FOUR
	db	CUE_CMD,SET_BRT, 0x00, SIX, 0		; SIX
	db	CUE_CMD,SET_BRT, 0x00, SEVEN, 0		; SEVEN
	db	CUE_CMD,SET_BRT, 0x00, EIGHT, 0		; EIGHT
	db	CUE_CMD,SET_BRT, 0x00, TEN, 0		; TEN_
	db	CUE_CMD,SET_BRT, 0x00, ELEVEN, 0		; ELEVEN
	db	CUE_CMD,SET_BRT, 0x00, TWELVE, 0		; TWELVE
	db	CUE_CMD,SET_BRT, 0x00, OCLOCK, 0		; O'CLOCK
	db	CUE_CMD,SET_BRT, 0x00, .22, 0		; PLUS 1
	db	CUE_CMD,SET_BRT, 0x00, .23, 0		; PLUS 2
	db	CUE_CMD,SET_BRT, 0x00, .24, 0		; PLUS 3
	db	CUE_CMD,SET_BRT, 0x00, .25, 0		; PLUS 4
;	db	CUE_CMD,WATCH,0x00,NEVER
	db	CUE_DONE

    endif

	END

